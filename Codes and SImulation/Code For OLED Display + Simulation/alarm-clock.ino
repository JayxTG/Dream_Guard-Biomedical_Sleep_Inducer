#include <Wire.h>
#include <Adafruit_GFX.h>
#include <Adafruit_SSD1306.h>
#include "Button.h"
#include "Clock.h"
#include "config.h"

const int COLON_PIN = 13;
const int SIGNAL_PIN = A3;

Button hourButton(A0);
Button minuteButton(A1);
Button alarmButton(A2);

Clock clock;
Adafruit_SSD1306 display(128, 64, &Wire);

#include <SPI.h>
#include <Wire.h>
#include <Adafruit_GFX.h>
#include <Adafruit_SSD1306.h>


// 'Monoline Tech Owl Logo (10)', 500x161px
const unsigned char logo [] PROGMEM = {
	0x00, 0x00, 0x00, 0x00, 0x00, 0x00, 0x00, 0x00, 0x00, 0x00, 0x00, 0x00, 0x00, 0x00, 0x00, 0x00, 
	0x00, 0x00, 0x00, 0x00, 0x00, 0x00, 0x00, 0x00, 0x00, 0x00, 0x00, 0x00, 0x00, 0x00, 0x00, 0x00, 
	0x00, 0x00, 0x00, 0x00, 0x00, 0x00, 0x00, 0x00, 0x00, 0x00, 0x00, 0x00, 0x00, 0x00, 0x00, 0x00, 
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	0x00, 0x00, 0x00, 0x00, 0x00, 0x00, 0x00, 0x00, 0x00, 0x00, 0x00, 0x00, 0x00, 0x00, 0x00, 0x00
};


const int epd_bitmap_allArray_LEN = 1;
const unsigned char* epd_bitmap_allArray[1] = {
	logo
};

enum DisplayState {
  DisplayClock,
  DisplayAlarmStatus,
  DisplayAlarmTime,
  DisplayAlarmActive,
};

DisplayState displayState = DisplayClock;
long lastStateChange = 0;
bool isAlarmTriggered = false;

void changeDisplayState(DisplayState newValue) {
  displayState = newValue;
  lastStateChange = millis();
}

long millisSinceStateChange() {
  return millis() - lastStateChange;
}

void setColon(bool value) {
  digitalWrite(COLON_PIN, value ? LOW : HIGH);
}

void displayTime() {
  DateTime now = clock.now();
  bool blinkState = now.second() % 2 == 0;
  
  display.clearDisplay();
  display.setTextSize(3);
  display.setTextColor(SSD1306_WHITE);
  
  int16_t x = (display.width() - (5 * 2 * 2)) / 5;
  int16_t y = (display.height() - (7 * 2)) / 2;
  
  String formattedHourNow = String(now.hour(), DEC).length() < 2 ? "0" + String(now.hour(), DEC) : String(now.hour(), DEC);
  String formattedMinuteNow = String(now.minute(), DEC).length() < 2 ? "0" + String(now.minute(), DEC) : String(now.minute(), DEC);

  display.setCursor(x, y);
  display.print(formattedHourNow);
  display.print(":");
  display.print(formattedMinuteNow);
  display.display();
  setColon(blinkState);
}

void clockState() {
  displayTime();

  if (alarmButton.read() == Button::RELEASED && clock.alarmActive()) {
    alarmButton.has_changed();
    changeDisplayState(DisplayAlarmActive);
    return;
  }

  if (hourButton.pressed()) {
    clock.incrementHour();
  }
  if (minuteButton.pressed()) {
    clock.incrementMinute();
  }
  if (alarmButton.pressed()) {
    clock.toggleAlarm();
    changeDisplayState(DisplayAlarmStatus);
  }

  DateTime now = clock.now();
  DateTime alarm = clock.alarmTime();
  if (now.hour() == alarm.hour() && now.minute() == alarm.minute()) {
    isAlarmTriggered = true;
  } else {
    isAlarmTriggered = false;
  }
}

void alarmStatusState() {
  setColon(false);
  display.clearDisplay();
  display.setTextSize(2);
  display.setTextColor(SSD1306_WHITE);
  
  display.setCursor(24, 4);
  display.println("Inducer");
  display.setCursor(56, 32);
  display.println(clock.alarmEnabled() ? "On" : "Off");

  display.display();

  if (millisSinceStateChange() > ALARM_STATUS_DISPLAY_TIME) {
    changeDisplayState(clock.alarmEnabled() ? DisplayAlarmTime : DisplayClock);
    return;
  }
}

void alarmTimeState() {
  DateTime alarm = clock.alarmTime();
  
  display.clearDisplay();
  display.setTextSize(2);
  display.setTextColor(SSD1306_WHITE);
  
  int16_t x = (display.width() - 23) / 2;
  
  display.setCursor(16, 4);
  display.print("Set Timer");

  String formattedHour = String(alarm.hour(), DEC).length() < 2 ? "0" + String(alarm.hour(), DEC) : String(alarm.hour(), DEC);
  String formattedMinute = String(alarm.minute(), DEC).length() < 2 ? "0" + String(alarm.minute(), DEC) : String(alarm.minute(), DEC);
  display.setTextSize(2);
  display.setCursor(32, 32);
  display.print(formattedHour);
  display.print(":");
  display.print(formattedMinute);
  display.println(" H");
  display.display();
  
  if (millisSinceStateChange() > ALARM_HOUR_DISPLAY_TIME || alarmButton.pressed()) {
    changeDisplayState(DisplayClock);
    return;
  }

  if (hourButton.pressed()) {
    clock.incrementAlarmHour();
    lastStateChange = millis();
  }
  if (minuteButton.pressed()) {
    clock.incrementAlarmMinute();
    lastStateChange = millis();
  }
  if (alarmButton.pressed()) {
    changeDisplayState(DisplayClock);
    isAlarmTriggered = false;
  }
}

void alarmState() {
  displayTime();

  if (clock.alarmActive()) {
    isAlarmTriggered = true;
    clock.toggleAlarm();
    changeDisplayState(DisplayAlarmStatus);
    return;
  }
}

void setup() {
  Serial.begin(115200);

  clock.begin();

  hourButton.begin();
  hourButton.set_repeat(500, 200);

  minuteButton.begin();
  minuteButton.set_repeat(500, 200);

  alarmButton.begin();
  alarmButton.set_repeat(1000, -1);

  pinMode(COLON_PIN, OUTPUT);
  pinMode(SIGNAL_PIN, OUTPUT);

  display.begin(SSD1306_SWITCHCAPVCC, 0x3C);
  display.clearDisplay();

  display.drawBitmap(0, 0, logo, 128, 64, WHITE);
  display.display();
  delay(1500);
  display.clearDisplay();

  display.setTextSize(2);
  display.setTextColor(SSD1306_WHITE);
  display.setCursor(24, 24);
  display.print("Welcome!");
  display.display();
  delay(1500);
  display.clearDisplay();

  display.display();


}

void loop() {

  bool state = clock.alarmEnabled();
  switch (displayState) {
    case DisplayClock:
      clockState();
      break;

    case DisplayAlarmStatus:
      alarmStatusState();
      break;

    case DisplayAlarmTime:
      alarmTimeState();
      break;

    case DisplayAlarmActive:
      alarmState();
      break;
  }
  if (!isAlarmTriggered && state) {
    digitalWrite(SIGNAL_PIN, HIGH);
    delay(74);
    digitalWrite(SIGNAL_PIN, LOW);
    delay(34);
  }
}